global &project
&project="mt6572td_evb1"
